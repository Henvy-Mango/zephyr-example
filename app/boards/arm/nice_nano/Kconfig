## app/boards/arm/nice_nano/Kconfig
```kconfig
# Adafruit ItsyBitsy nRF52840 Express board configuration

# Copyright (c) 2022 Embla Flatlandsmo <embla.flatlandsmo@gmail.com>
# SPDX-License-Identifier: Apache-2.0

config BOARD_ENABLE_DCDC
    bool "Enable DCDC mode"
    select SOC_DCDC_NRF52X
    default y
    depends on BOARD_NICE_NANO

config BOARD_ENABLE_DCDC_HV
    bool "High voltage DCDC converter"
    select SOC_DCDC_NRF52X_HV
    default y
    depends on BOARD_NICE_NANO
```

## app/boards/arm/nice_nano/Kconfig.nice_nano
```kconfig
# nice!nano board configuration

# Copyright (c) 2020 Pete Johanson
# SPDX-License-Identifier: MIT

config BOARD_NICE_NANO
    select SOC_NRF52840_QIAA
```

## app/boards/arm/nice_nano/nice_nano_defconfig
```kconfig
# SPDX-License-Identifier: MIT

# Enable MPU
CONFIG_ARM_MPU=y

# Enable hardware stack protection
CONFIG_HW_STACK_PROTECTION=y

# Use pinctrl
CONFIG_PINCTRL=y

# enable GPIO
CONFIG_GPIO=y

# Flashing
CONFIG_USE_DT_CODE_PARTITION=y
CONFIG_BUILD_OUTPUT_UF2=y
```

## app/drivers/input/Kconfig
```kconfig
# Copyright (c) 2022 The ZMK Contributors
# SPDX-License-Identifier: MIT

menuconfig INPUT_MPR121
    bool "NXP MPR121 Capacitive Touch"
    default y
    depends on GPIO
    depends on I2C
    depends on INPUT
    help
      Enable driver for NXP MPR121 based capacitive touch

if INPUT_MPR121

config INPUT_MPR121_INIT_PRIORITY
    int "NXP MPR121 initialization priority"
    default INPUT_INIT_PRIORITY


endif
```
